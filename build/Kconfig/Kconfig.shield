## build/Kconfig/Kconfig.shield
```kconfig
osource "f:/nrf5340-dk-project/secondproject/boards/shields/*/Kconfig.shield"
osource "d:/software/ncs/v2.3.0/nrf/samples/bluetooth/peripheral_uart/boards/shields/*/Kconfig.shield"
osource "D:/Software/ncs/v2.3.0/nrf/boards/shields/*/Kconfig.shield"
```

## build/Kconfig/Kconfig.shield.defconfig
```kconfig
osource "f:/nrf5340-dk-project/secondproject/boards/shields/*/Kconfig.defconfig"
osource "d:/software/ncs/v2.3.0/nrf/samples/bluetooth/peripheral_uart/boards/shields/*/Kconfig.defconfig"
osource "D:/Software/ncs/v2.3.0/nrf/boards/shields/*/Kconfig.defconfig"
```
