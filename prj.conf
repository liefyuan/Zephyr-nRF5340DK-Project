## CMakeLists.txt
```
cmake_minimum_required(VERSION 3.20.0)
find_package(Zephyr REQUIRED HINTS $ENV{ZEPHYR_BASE})
project(SecondProject)

target_sources(app PRIVATE 
    src/main.c src/led_key_logic.c src/uart_logic.c
)
zephyr_include_directories(src)
```

## prj.conf
```kconfig
# Enable DK LED and Buttons library
CONFIG_DK_LIBRARY=y

# Enable DK serial function
CONFIG_SERIAL=y
CONFIG_UART_INTERRUPT_DRIVEN=y
```

## nrf5340dk_nrf5340_cpuapp.overlay
```dts
// To get started, press Ctrl+Space to bring up the completion menu and view the available nodes.

// You can also use the buttons in the sidebar to perform actions on nodes.
// Actions currently available include:

// * Enabling / disabling the node
// * Adding the bus to a bus
// * Removing the node
// * Connecting ADC channels

// For more help, browse the DeviceTree documentation at https://docs.zephyrproject.org/latest/guides/dts/index.html
// You can also visit the nRF DeviceTree extension documentation at https://nrfconnect.github.io/vscode-nrf-connect/devicetree/nrfdevicetree.html
/ {
	chosen {
		nordic,liefyuan-uart = &uart1;
	};
};

&uart1 {
	status = "okay";
	current-speed = <115200>;
};
```

## boards/vvfly_nrf5340_cpuapp.overlay
```dts
/*
 * Copyright (c) 2021 Nordic Semiconductor ASA
 *
 * SPDX-License-Identifier: LicenseRef-Nordic-5-Clause
 */

/ {
	chosen {
		nordic,nus-uart = &cdc_acm_uart1;
		nordic,liefyuan-uart = &uart1;
	};
};

&uart0 {
	status = "okay";
	current-speed = <115200>;
	tx-pin = <25>;
	rx-pin = <26>;
};

&uart1 {
	status = "okay";
	current-speed = <115200>;
	tx-pin = <30>;
	rx-pin = <31>;
};
```

## src/main.c
```c
#include <zephyr/sys/printk.h>
#include <zephyr/kernel.h>

#include "led_key_logic.h"
#include "uart_logic.h"

void main(void)
{
    led_key_gpio_init();
    uart_init();

    for(;;)
    {
        uart_event_handle();
        //printk("FirstProject test start !!!\r\n");
        //k_sleep(K_MSEC(1000));
    }
}
```

## src/led_key_logic.c
```c
#include <zephyr/sys/printk.h>

#include "led_key_logic.h"
#include <dk_buttons_and_leds.h>

#define SetBit(x, y)   (x |= (1<<y))      // 特定位置1,x为目标,y为第几位
#define ClearBit(x, y) (x &= ~(1<<y))     // 特定位清0
#define GetBit(x, y)   (x &= (1<<y))      // 特定位取值
#define ReveBit(x, y)  (x ^= (1<<y))      // 特定位取反

static void button_changed(uint32_t button_state, uint32_t has_changed)
{
	uint32_t buttons = button_state & has_changed;
    static uint8_t state = 0;

    if (buttons & DK_BTN1_MSK) {
        printk("Button_1 Click\r\n");
        if(GetBit(state, 1) == 0)
        {
            dk_set_led_on(DK_LED1);
            SetBit(state, 1);
        }
        else
        {
            dk_set_led_off(DK_LED1);
            ClearBit(state, 1);
        }
    }

    if (buttons & DK_BTN2_MSK) {
        printk("Button_2 Click\r\n");
        if(GetBit(state, 2) == 0)
        {
            dk_set_led_on(DK_LED2);
            SetBit(state, 2);
        }
        else
        {
            dk_set_led_off(DK_LED2);
            ClearBit(state, 2);
        }
    }

    if (buttons & DK_BTN3_MSK) {
        printk("Button_3 Click\r\n");
        if(GetBit(state, 3) == 0)
        {
            dk_set_led_on(DK_LED3);
            SetBit(state, 3);
        }
        else
        {
            dk_set_led_off(DK_LED3);
            ClearBit(state, 3);
        }
    }

    if (buttons & DK_BTN4_MSK) {

        printk("Button_4 Click\r\n");
        if(GetBit(state, 4) == 0)
        {
            dk_set_led_on(DK_LED4);
            SetBit(state, 4);
        }
        else
        {
            dk_set_led_off(DK_LED4);
            ClearBit(state, 4);
        }
    }
}

void led_key_gpio_init(void)
{
	int err;

	err = dk_buttons_init(button_changed);
	if (err) {
		printk("Cannot init buttons (err: %d)", err);
	}

	err = dk_leds_init();
	if (err) {
		printk("Cannot init LEDs (err: %d)", err);
	}

    printk("leds keys init ok!\r\n");
}
```

## src/led_key_logic.h
```c
#ifndef _LED_KEY_LOGIC_H_
#define _LED_KEY_LOGIC_H_


void led_key_gpio_init(void);


#endif // _LED_KEY_LOGIC_H_
```

## src/uart_logic.c
```c
#include <zephyr/kernel.h>
#include <zephyr/device.h>
#include <zephyr/drivers/uart.h>
#include <zephyr/sys/printk.h>
#include <zephyr/devicetree.h>

#include "uart_logic.h"

#include <string.h>

/*
* current file come from: ncs\v2.3.0\zephyr\samples\drivers\uart\echo_bot\src
*/

/* change this to any other UART peripheral if desired */
#define UART_DEVICE_NODE DT_CHOSEN(nordic_liefyuan_uart)

#define MSG_SIZE 32

/* queue to store up to 10 messages (aligned to 4-byte boundary) */
K_MSGQ_DEFINE(uart_msgq, MSG_SIZE, 10, 4);

static const struct device *const uart_dev = DEVICE_DT_GET(UART_DEVICE_NODE);

/* receive buffer used in UART ISR callback */
static char rx_buf[MSG_SIZE];
static int rx_buf_pos;

char tx_buf[MSG_SIZE];

/*
 * Read characters from UART until line end is detected. Afterwards push the
 * data to the message queue.
 */
static void serial_cb(const struct device *dev, void *user_data)
{
	uint8_t c;

	if (!uart_irq_update(uart_dev)) {
		return;
	}

	while (uart_irq_rx_ready(uart_dev)) {
		uart_fifo_read(uart_dev, &c, 1);

		if ((c == '\n' || c == '\r') && rx_buf_pos > 0) {
			/* terminate string */
			rx_buf[rx_buf_pos] = '\0';

			/* if queue is full, message is silently dropped */
			k_msgq_put(&uart_msgq, &rx_buf, K_NO_WAIT);

			/* reset the buffer (it was copied to the msgq) */
			rx_buf_pos = 0;
		} else if (rx_buf_pos < (sizeof(rx_buf) - 1)) {
			rx_buf[rx_buf_pos++] = c;
		}
		/* else: characters beyond buffer size are dropped */
	}
}

/*
 * Print a null-terminated string character by character to the UART interface
 */
static void print_uart(char *buf)
{
	int msg_len = strlen(buf);

	for (int i = 0; i < msg_len; i++) {
		uart_poll_out(uart_dev, buf[i]);
	}
}

void uart_init(void)
{
	if (!device_is_ready(uart_dev)) {
		printk("UART device not found!");
		return;
	}
    else
    {
        printk("uart1 ready!\r\n");
    }

	/* configure interrupt and callback to receive data */
	uart_irq_callback_user_data_set(uart_dev, serial_cb, NULL);
	uart_irq_rx_enable(uart_dev);

	print_uart("Hello! I'm your echo bot.\r\n");
	print_uart("Tell me something and press enter:\r\n");
}

void uart_event_handle(void)
{
    /* indefinitely wait for input from the user */
	while (k_msgq_get(&uart_msgq, &tx_buf, K_FOREVER) == 0) {
		print_uart("Echo: ");
		print_uart(tx_buf);
		print_uart("\r\n");
	}
}
```

## src/uart_logic.h
```c
#ifndef _UART_LOGIC_H_
#define _UART_LOGIC_H_

void uart_init(void);

void uart_event_handle(void);


#endif // _UART_LOGIC_H_
```
